AUTOSAR XML (schema 00049)
package /Demo
  ecuc value collection Selected: ecuc-values=[/Demo/Os, /Demo/Rte]
