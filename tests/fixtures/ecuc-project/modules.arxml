AUTOSAR XML (schema 00049)
package /Demo
  module config Os: definition=/Synthetic/Os
    Task10ms (OsTask)
  module config Rte: definition=/Synthetic/Rte
    Event10ms (RteEventToTaskMapping): RteEventRef=/External/Behavior/Timer, RteMappedToTaskRef=/Demo/Os/Task10ms
  module config Unused: definition=/Synthetic/Unused
    UnusedEvent (RteEventToTaskMapping)
