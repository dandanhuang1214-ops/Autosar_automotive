AUTOSAR XML (schema 4.0)
package /Demo
  module config Com: definition=/Synthetic/Com
    ValueA (ComSignal)
    GroupB (ComSignalGroup)
      ValueB (ComGroupSignal)
    PacketA (ComIPdu): ComIPduDirection=SEND, ComIPduSignalRef=/Demo/Com/ValueA, ComPduIdRef=/Demo/EcuC/A
    PacketB (ComIPdu): ComIPduDirection=RECEIVE, ComIPduSignalGroupRef=/Demo/Com/GroupB, ComPduIdRef=/Demo/EcuC/B
  module config EcuC: definition=/Synthetic/EcuC
    4 x Pdu:
      A
      B
      C
      D
  module config PduR: definition=/Synthetic/PduR
    RouteA (PduRRoutingPath)
      Start (PduRSrcPdu): PduRSrcPduRef=/Demo/EcuC/A
      End (PduRDestPdu): PduRDestPduRef=/Demo/EcuC/C
    RouteB (PduRRoutingPath)
      Start (PduRSrcPdu): PduRSrcPduRef=/Demo/EcuC/D
      End (PduRDestPdu): PduRDestPduRef=/Demo/EcuC/B
  module config CanIf: definition=/Synthetic/CanIf
    PortA (CanIfTxPduCfg): CanIfTxPduRef=/Demo/EcuC/C, CanIfTxPduBufferRef=/Demo/CanIf/Buffer
    PortB (CanIfRxPduCfg): CanIfRxPduRef=/Demo/EcuC/D, CanIfRxPduHrhIdRef=/Demo/CanIf/HandleB
    Buffer (CanIfBufferCfg): CanIfBufferHthRef=/Demo/CanIf/HandleA
    HandleA (CanIfHthCfg): CanIfHthIdSymRef=/Demo/Can/ObjectA
    HandleB (CanIfHrhCfg): CanIfHrhIdSymRef=/Demo/Can/ObjectB
  module config Can: definition=/Synthetic/Can
    ObjectA (CanHardwareObject): CanObjectType=TRANSMIT, CanControllerRef=/Demo/Can/Controller
    ObjectB (CanHardwareObject): CanObjectType=RECEIVE, CanControllerRef=/Demo/Can/Controller
    Controller (CanController)
