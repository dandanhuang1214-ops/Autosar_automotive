AUTOSAR XML (schema 4.0)
package /Demo
  ecuc value collection Selected: ecuc-values=[/Demo/Com, /Demo/EcuC, /Demo/PduR, /Demo/CanIf, /Demo/Can, /Demo/Os, /Demo/Rte, /Demo/BswM]
