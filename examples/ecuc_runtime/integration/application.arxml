AUTOSAR XML (schema 4.0)
package /App
  composition sw component type Composition
    component Instance: type=/App/Worker
  application sw component type Worker
    behavior Behavior
      timing event Tick: start-on-event=/App/Worker/Behavior/Run, period=0.010
      runnable Run
  bsw module description Basic
    bsw internal behavior Behavior
      bsw timing event Tick: starts-on-event=/App/Basic/Behavior/Run, period=0.010
      bsw schedulable entity Run
