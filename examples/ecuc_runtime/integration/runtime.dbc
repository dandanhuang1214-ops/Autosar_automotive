VERSION "P29 synthetic"
NS_ :

BS_:
BU_: BODY_ECU TESTER
BO_ 256 WindowStatus: 8 BODY_ECU
 SG_ WindowPosition : 0|8@1+ (1,0) [0|100] "%" TESTER
BO_ 512 WindowCommand: 8 TESTER
 SG_ RequestedDirection : 0|2@1+ (1,0) [0|3] "" BODY_ECU
