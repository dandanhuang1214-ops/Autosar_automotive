AUTOSAR XML (schema 4.0)
package /Telemetry
  module config Com: definition=/Synthetic/Com
    ValueA (ComSignal): ComBitSize=8
    PacketA (ComIPdu): ComIPduDirection=SEND, ComIPduSignalRef=/Telemetry/Com/ValueA, ComPduIdRef=/Telemetry/EcuC/A
  module config EcuC: definition=/Synthetic/EcuC
    A (Pdu)
    C (Pdu)
  module config PduR: definition=/Synthetic/PduR
    RouteA (PduRRoutingPath)
      Start (PduRSrcPdu): PduRSrcPduRef=/Telemetry/EcuC/A
      End (PduRDestPdu): PduRDestPduRef=/Telemetry/EcuC/C
  module config CanIf: definition=/Synthetic/CanIf
    PortA (CanIfTxPduCfg): CanIfTxPduRef=/Telemetry/EcuC/C, CanIfTxPduBufferRef=/Telemetry/CanIf/Buffer, CanIfTxPduCanId=768
    Buffer (CanIfBufferCfg): CanIfBufferHthRef=/Telemetry/CanIf/HandleA
    HandleA (CanIfHthCfg): CanIfHthIdSymRef=/Telemetry/Can/ObjectA
  module config Can: definition=/Synthetic/Can
    ObjectA (CanHardwareObject): CanObjectType=TRANSMIT, CanControllerRef=/Telemetry/Can/Controller
    Controller (CanController)
