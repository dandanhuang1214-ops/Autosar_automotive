AUTOSAR XML (schema 4.0)
package /Telemetry
  ecuc value collection Selected: ecuc-values=[/Telemetry/Com, /Telemetry/EcuC, /Telemetry/PduR, /Telemetry/CanIf, /Telemetry/Can]
